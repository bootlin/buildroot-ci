## configs/ci_common_defconfig
```kconfig
BR2_arm=y
BR2_TOOLCHAIN_EXTERNAL=y
BR2_ROOTFS_OVERLAY="board/ci/overlay"
BR2_PACKAGE_BUSYBOX_CONFIG="board/ci/busybox.config"
BR2_PACKAGE_BONNIE=y
BR2_PACKAGE_DT=y
BR2_PACKAGE_E2FSPROGS=y
BR2_PACKAGE_MTD=y
BR2_PACKAGE_MTD_TESTS=y
BR2_PACKAGE_MTD_FLASH_READTEST=y
BR2_PACKAGE_MTD_FLASH_SPEED=y
BR2_PACKAGE_MTD_FLASH_STRESS=y
BR2_PACKAGE_MTD_FLASH_TORTURE=y
BR2_PACKAGE_MTD_INTEGCK=y
BR2_PACKAGE_MTD_NANDBITERRS=y
BR2_PACKAGE_MTD_NANDPAGETEST=y
BR2_PACKAGE_MTD_NANDSUBPAGETEST=y
BR2_PACKAGE_IPERF=y
BR2_PACKAGE_IPUTILS=y
BR2_PACKAGE_UTIL_LINUX_BINARIES=y
BR2_PACKAGE_UTIL_LINUX_MOUNT=y
BR2_TARGET_ROOTFS_CPIO=y
BR2_TARGET_ROOTFS_CPIO_GZIP=y
BR2_TARGET_ROOTFS_CPIO_UIMAGE=y
BR2_TARGET_ROOTFS_TAR_GZIP=y
BR2_PACKAGE_DHCP=y
BR2_PACKAGE_DHCP_CLIENT=y
```

## configs/ci_defconfig
```kconfig
BR2_arm=y
BR2_TARGET_ROOTFS_CPIO=y
BR2_TARGET_ROOTFS_CPIO_GZIP=y
BR2_TARGET_ROOTFS_CPIO_UIMAGE=y
# BR2_TARGET_ROOTFS_TAR is not set
```

## package/netsum/Config.in
```kconfig
config BR2_PACKAGE_NETSUM
	bool "netsum"
	help
	  Simple tool to check network I/Os

	  http://git.lacie-nas.org/?p=netsum.git;a=summary
```

## package/netsum/Config.in.host
```kconfig
config BR2_PACKAGE_HOST_NETSUM
	bool "host-netsum"
	help
	  Simple tool to check network I/Os

	  http://git.lacie-nas.org/?p=netsum.git;a=summary
```
